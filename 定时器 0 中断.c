/* ----------------------------------------------------------------------------- */
/* ---		作者： 捷立纳电子品牌原创店(Jellina Electronics)  ------------------ */ 
/* ---		淘宝店铺：https://shop401502656.taobao.com/       ------------------ */
/* ---		欢迎大家光顾小店                                  ------------------ */
/* ---		参考：宏晶科技的资料及程序                        ------------------ */
/* ----------------------------------------------------------------------------- */
#define u32 unsigned int

#include "reg51.h"
#include "intrins.h"
//测试工作频率为 11.0592MHz

void TM0_Isr() interrupt 1 using 1
{
	if(g_TM0_Isr_cnt++ >= 2000)
	{
		g_TM0_Isr_cnt = 0;
		P10 = !P10; //测试端口     
	}
	               
}

void TM1_Isr() interrupt 3 using 1
{
	if(g_TM1_Isr_cnt++ >= 100)
	{
		g_TM1_Isr_cnt = 0;
		P11 = !P11; //测试端口     
	}
}
void main()
{
TMOD = 0x00;
TL0 = 0x66; //65536-11.0592M/12/1000
TH0 = 0xfc;
TR0 = 1; //启动定时器
ET0 = 1; //使能定时器中断
TL1 = 0x66;
TH1 = 0xfc;
TR1 = 1;
ET1 = 1;
EA = 1;
while (1);
}